#include "timer.h"
#include "adc.h"
#include "iir.h" 
#include "usart.h"
#include "oled.h"
#include "dac.h"
#include "pwm.h"
#include "PID.h"

extern int n;
extern __IO uint16_t ADC_ConvertedValue[4];
float ADC_ConvertedValueLocal[4]={0}; 

double K=0.6;
double dt1,dt2,sum,sum0,sum1,sum2,Vi,Vread0,Vread1,dt=0;
int flag=-1,FLAG=-1,FLAG1=-1;
int num=0,num0=0,num1=0,num2=0,count=0;

uint16_t POINT_NUM =400;
__IO uint16_t period_class = 1;
double high=0;
const uint16_t indexWave[] = {
2000, 2032, 2063, 2095, 2126, 2158, 2189, 2220, 2252, 2283, 2314, 2345,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 2000,
2000, 2032, 2063, 2095, 2126, 2158, 2189, 2220, 2252, 2283, 2314, 2345,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 2000,
2000, 2032, 2063, 2095, 2126, 2158, 2189, 2220, 2252, 2283, 2314, 2345,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 1968, 2000};	
	
	void TIM3_Int_Init(u16 arr,u16 psc)//spwm采点定时器配置
{
	TIM_TimeBaseInitTypeDef TIM_TimeBaseInitStructure;
	NVIC_InitTypeDef NVIC_InitStructure;
	
	RCC_APB1PeriphClockCmd(RCC_APB1Periph_TIM3,ENABLE);  ///使能TIM3时钟
	
  TIM_TimeBaseInitStructure.TIM_Period = arr; 	//自动重装载值
	TIM_TimeBaseInitStructure.TIM_Prescaler=psc;  //定时器分频
	TIM_TimeBaseInitStructure.TIM_CounterMode=TIM_CounterMode_Up; //向上计数模式
	TIM_TimeBaseInitStructure.TIM_ClockDivision=TIM_CKD_DIV1; 
	
	TIM_TimeBaseInit(TIM3,&TIM_TimeBaseInitStructure);//初始化TIM3
	
	TIM_ITConfig(TIM3,TIM_IT_Update,ENABLE); //允许定时器3更新中断
	TIM_Cmd(TIM3,ENABLE); //使能定时器3
	
	NVIC_InitStructure.NVIC_IRQChannel=TIM3_IRQn; //定时器3中断
	NVIC_InitStructure.NVIC_IRQChannelPreemptionPriority=0x00; //抢占优先级1
	NVIC_InitStructure.NVIC_IRQChannelSubPriority=0x01;
	NVIC_InitStructure.NVIC_IRQChannelCmd=ENABLE;
	NVIC_Init(&NVIC_InitStructure);
	
}

void  TIM3_IRQHandler(void)//采点中断函数
{			//用于PWM查表
	static uint16_t period_cnt = 0;		//用于计算周期数
	static uint16_t pwm_index = 0;
	
	if (TIM_GetITStatus(TIM3, TIM_IT_Update) != RESET)	//TIM_IT_Update
 	{			
			period_cnt++;
			TIM8->CCR1 = 2000+K*(indexWave[pwm_index]-2000);	//根据PWM表修改定时器的比较寄存器值
		  TIM8->CCR2 = 3999-(2000+K*(indexWave[pwm_index]-2000));
			if(period_cnt >=period_class)				 				
			{				
				pwm_index++;
					}												//标志PWM表指向下一个元素
				if(pwm_index >=POINT_NUM)
				{					
					pwm_index=0;				  					
				}			
				period_cnt=0;		
				count=pwm_index;
			}	
	TIM_ClearITPendingBit (TIM3, TIM_IT_Update);	//必须要清除中断标志位
	}		
	

	
	
void TIM4_Int_Init(u16 arr,u16 psc)//计时定时器配置
{
	TIM_TimeBaseInitTypeDef TIM_TimeBaseInitStructure;
	NVIC_InitTypeDef NVIC_InitStructure;
	
	RCC_APB1PeriphClockCmd(RCC_APB1Periph_TIM4,ENABLE);
	
  TIM_TimeBaseInitStructure.TIM_Period = arr; 	//自动重装载值
	TIM_TimeBaseInitStructure.TIM_Prescaler=psc;  //定时器分频
	TIM_TimeBaseInitStructure.TIM_CounterMode=TIM_CounterMode_Up; //向上计数模式
	TIM_TimeBaseInitStructure.TIM_ClockDivision=TIM_CKD_DIV1; 
	
	TIM_TimeBaseInit(TIM4,&TIM_TimeBaseInitStructure);//初始化TIM3
	
	TIM_ITConfig(TIM4,TIM_IT_Update,ENABLE); //允许定时器3更新中断
	TIM_Cmd(TIM4,ENABLE); //使能定时器3
	
	NVIC_InitStructure.NVIC_IRQChannel=TIM4_IRQn; //定时器3中断
	NVIC_InitStructure.NVIC_IRQChannelPreemptionPriority=0x00;//
	NVIC_InitStructure.NVIC_IRQChannelSubPriority=0x03; //子优先级3
	NVIC_InitStructure.NVIC_IRQChannelCmd=ENABLE;
	NVIC_Init(&NVIC_InitStructure);
	
}




void TIM4_IRQHandler(void)
{
if (TIM_GetITStatus(TIM4, TIM_IT_Update) != RESET){
	if(num0<10){
	ADC_ConvertedValueLocal[0] =(float) ADC_ConvertedValue[0];
	sum0+=ADC_ConvertedValueLocal[0];
	num0++;
	}
	else{
	Vread0=sum0/(double)num0;
	Vread1=indexWave[count];	
	if(Vread0>(Vi+2)){
	flag=1;
	}
	if(Vread0<(Vi-2)){ 
	flag=0;
	}
	
	if(Vread1>(2000)){
	dt2=4095;
	if(flag==0){
	if(FLAG==0){
	FLAG1=0;
	FLAG=-1;
	}//落后
	if(FLAG1==0){dt1=0;}
	else{dt1=4095;}
	}
	if(flag==1){
	if(FLAG1==0){dt1=2047;}
	else{dt1=2047;}
	FLAG=0;
	}}
	
	if(Vread1<(2000)){
	dt2=0; 
	if(flag==1){
	if(FLAG==0){
	FLAG1=1;
	FLAG=-1;
	}
	if(FLAG1==1){dt1=4095;}
	else{dt1=0;}
	}
	if(flag==0){
  if(FLAG1==1){dt1=2047;}
	else{dt1=2047;}}
	}
	sum0=0;
	sum1=0;
	num0=0;
	
	}
	
  if(num<100){
	num++;
	}
	else{
	ADC_ConvertedValueLocal[0] =(float) ADC_ConvertedValue[0];
	Vi=IIR_Realize(ADC_ConvertedValueLocal[0]);
	dt=IIR_Realize(dt1);
	Dac1_Set_Vol(dt);
	num=0;
	}

TIM_ClearITPendingBit (TIM4, TIM_IT_Update);
}}


